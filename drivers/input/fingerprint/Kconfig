## drivers/misc/mediatek/sensors-1.0/sensorHub/Kconfig
```kconfig
config CUSTOM_KERNEL_SENSORHUB
	bool "CUSTOM KERNEL SENSORHUB support"
	help
	  Kernel space sensor hub driver.
	  Define project used all sensor hub
	  sensors. The value is combination of sensor hub driver(get data...etc)
	  and sensor hub framework driver(transmit shf info)

# begin, prize-lifenfen-20181126, add for sensorhub hardware info
config SENSORHUB_PRIZE_HARDWARE_INFO
	depends on CUSTOM_KERNEL_SENSORHUB
        bool "SENSORHUB PRIZE HARDWARE INFO support"
        help
          Kernel space sensor hub driver hardware info.

config SENSORHUB_PRIZE_HARDWARE_INFO_SIZE
        depends on SENSORHUB_PRIZE_HARDWARE_INFO
        bool "SENSORHUB PRIZE HARDWARE INFO SIZE support"
        help
          Kernel space sensor hub driver hardware info size.
# end, prize-lifenfen-20181126, add for sensorhub hardware info
#source "drivers/misc/mediatek/sensors-1.0/sensorHub/SCP_sensorHub/Kconfig"
#source "drivers/misc/mediatek/sensors-1.0/sensorHub/SCP_sensorHub_v1/Kconfig"
#source "drivers/misc/mediatek/sensors-1.0/sensorHub/SCP_shf/Kconfig"
```

## drivers/misc/mediatek/sensors-1.0/step_counter/Kconfig
```kconfig
config CUSTOM_KERNEL_STEP_COUNTER
	bool "CUSTOM_KERNEL_STEP_COUNTER"
	help
	  A step counter is a device, usually portable and electronic or electromechanical,
	  that counts each step a person takes by detecting the motion of the person's hands or hips.

config CUSTOM_KERNEL_SIGNIFICANT_MOTION
	bool "open significant motion"
	help
	  Kernel space sigificant motion sensor driver.

source "drivers/misc/mediatek/sensors-1.0/step_counter/stepsignhub/Kconfig"


#prize added by huarui, sensor driver, 20190111-start
source "drivers/misc/mediatek/sensors-1.0/step_counter/bmi160-stc/Kconfig"
#prize added by huarui, sensor driver, 20190111-end
```
