## drivers/input/fingerprint/Kconfig
```kconfig
#
#Fingerprint
#
menu "Fingerprint support"
	depends on INPUT

config SUNWAVE_TEE_FINGERPRINT
    bool "SW Fingerprint"
    default n
    ---help---
    SW fingerprint chip.

config MTK_FINGERPRINT_SUPPORT
	bool "Mediatek Fingerprint"
	default n
	help
	  Fingerprint mtk driver enable/disable in the kernel.
	  Say Y here if you want to use mediatek fingerprint driver,
	  fingerprint driver will support fingerprint function
#prize-add-pengzhipeng-20200302-start
config NAVIGATION_FUNCTION 
       bool "Sunwave Fingerprint"
       default y
	---help---
     Navigation function up f1 down f2 left f3 right f4
#prize-add-pengzhipeng-20200302-end

if MTK_FINGERPRINT_SUPPORT
config MTK_FINGERPRINT_SELECT
	string "sensor type"
	default "GF318M"


if MTK_FINGERPRINT_SELECT = "FPC1145"
config FPC_FINGERPRINT
	bool "FPC Fingerprint"
	default y
	help
	  FPC fingerprint FPC's 102x/104x device.
endif

if MTK_FINGERPRINT_SELECT = "GF318M" ||  MTK_FINGERPRINT_SELECT = "GF5216"
config GOODIX_FINGERPRINT
	bool "Goodix Fingerprint"
	default y
	help
	  Goodix Fingerprint chip GF316M/GF318M/GF3118M/GF518M/GF5118M/GF516M/GF816M/GF3208/GF3206/
	  GF3266/GF3288/GF5206/GF5216/GF5208 TEE driver

config GOODIX_SENSOR_TYPE
	string "SENSOR_TYPE"
	default "GF5216"
	help
	  Must input sensor type, or default is GF316M GF318M GF3118M GF518M GF5118M GF516M GF816M
	  GF3208 GF3206 GF3266 GF3288 GF5206 GF5216 GF5208
endif
#prize-add-pengzhipeng-20191105-start
#prize add by lipengpeng 20191217 start 
if MTK_FINGERPRINT_SELECT = "microarray_fp"
  config MICROARRAY_FINGERPRINT
     bool "SUNWAVE Fingerprint"
     default y
     ---help---
     MICROARRAY fingerprint SUNWAVE's device.
endif
if MTK_FINGERPRINT_SELECT = "sunwavecorp_fp"
  config SUNWAVE_FINGERPRINT
     bool "SUNWAVE Fingerprint"
     default y
     ---help---
     MICROARRAY fingerprint SUNWAVE's device.
endif
#prize add by lipengpeng 20191217 end
if MTK_FINGERPRINT_SELECT = "ft9362"
  config FT9362_FINGERPRINT
     bool "FT9362 Fingerprint"
     default y
     ---help---
     MICROARRAY fingerprint FT9362's device.
endif

if MTK_FINGERPRINT_SELECT = "ft9362_tee"
  config FT9362_FINGERPRINT_TEE
     bool "FT9362 TEE Fingerprint"
     default y
     ---help---
     MICROARRAY fingerprint FT9362 TEE's device.
endif
if MTK_FINGERPRINT_SELECT = "sunwave_driver_all_in_one"
  config MTK_FINGERPRINT_SUNWAVECORP
       bool "Sunwave Fingerprint"
       default y
	---help---
     MICROARRAY fingerprint Sunwave's device.
endif
#prize-add-pengzhipeng-20191105-end
endif
endmenu
```

## drivers/input/touchscreen/mediatek/Kconfig
```kconfig
#
# Touchscreen driver configuration
#
menuconfig INPUT_TOUCHSCREEN
	bool "Touchscreens"
	help
	  Say Y here, and a list of supported touchscreens will be displayed.
	  This option doesn't affect the kernel.

	  If unsure, say Y.

if INPUT_TOUCHSCREEN

config TOUCHSCREEN_MTK
	bool "MediaTek Touch Panel Driver"
	help
	  Say Y here if you have MediaTek touch panel.

	  If unsure, say N.

	  To compile this dirver as a module, choose M here: the
	  module will be called.

config TOUCHSCREEN_PHYSICAL_ROTATION_WITH_LCM
	bool "MediaTek Touch Panel Rotation With LCM"
	default y
	help
	  Say N here if touch panel is not physical rotated as LCM does.
	  Physically rotated means that this driver will map
	  the reported coordination to diagonal position.

	  If unsure, say Y.
config TOUCHSCREEN_MTK_SOLOMON
	bool "SOLOMON for Mediatek package"
	default n
	help
	  Say Y here if you have SOLOMON touch panel.

	  If unsure, say N.

	  To compile this dirver as a module, choose M here: the
	  module will be called.

source "drivers/input/touchscreen/mediatek/SOLOMON/Kconfig"

config TOUCHSCREEN_MTK_FOCALTECH_TS
	bool "FOCALTECH_TS for Mediatek package"
	default n
	help
	  Say Y here if you have focaltech_touch touch panel.

	  If unsure, say N.

	  To compile this dirver as a module, choose M here: the
	  module will be called.

source "drivers/input/touchscreen/mediatek/focaltech_touch/Kconfig"
config TOUCHSCREEN_MTK_GT1151
	bool "GT1151 for Mediatek package"
	default n
	help
	  Say Y here if you have GT1151 touch panel.

	  If unsure, say N.

	  To compile this dirver as a module, choose M here: the
	  module will be called.

source "drivers/input/touchscreen/mediatek/GT1151/Kconfig"

#prize-add-hx83102-pengzhipeng-20200304-start
config TOUCHSCREEN_HIMAX_CHIPSET
         bool "hx83102 for Mediatek package"
         default n
         help
           Say Y here if you have hx83102 touch panel.

           If unsure, say N.

         help
           Say Y here if you have hx83102 touch panel.

           If unsure, say N.

           To compile this dirver as a module, choose M here: the
           module will be called.

source "drivers/input/touchscreen/mediatek/hxchipset/Kconfig"
#prize-add-hx83102-pengzhipeng-20200304-end

config TOUCHSCREEN_MTK_NT36xxx
	bool "NT36xxx for Mediatek package"
	default n
	help
	  Say Y here if you have NT36xxx touch panel.

	  If unsure, say N.

	  To compile this dirver as a module, choose M here: the
	  module will be called.

source "drivers/input/touchscreen/mediatek/NT36xxx/Kconfig"


config TOUCHSCREEN_MTK_NT36572_COMMON
         bool "NT36572 for Mediatek package"
         default n
         help
           Say Y here if you have NT36572 touch panel.

           If unsure, say N.

         help
           Say Y here if you have NT36572 touch panel.

           If unsure, say N.

           To compile this dirver as a module, choose M here: the
           module will be called.

source "drivers/input/touchscreen/mediatek/nt36572_common/Kconfig"

#prize-add HX83112-pengguangyi-20190119-start

config TOUCHSCREEN_MTK_HX83112
	bool "HX83112 for Mediatek package"
	default n
	help
	  Say Y here if you have HX83112 touch panel.

	  If unsure, say N.

	  To compile this dirver as a module, choose M here: the
	  module will be called.

source "drivers/input/touchscreen/mediatek/HX83112/Kconfig"

#prize-add HX83112-pengguangyi-20190119-end

config TOUCHSCREEN_MTK_FOCALTECH_HD
	bool "Focaltech Touchscreen"
	depends on I2C
	help
	  Say Y here if you have Focaltech touch panel.
	  If unsure, say N.
#prize-add-pengzhipeng-20191029-start
config TOUCHSCREEN_MTK_FOCALTECH_TS_V3
	bool "FT8006 for Mediatek package"
	default n
	help
	  Say Y here if you have FT8006 touch panel.
	  If unsure, say N.
	  To compile this dirver as a module, choose M here: the
	  module will be called.
#prize-add-pengzhipeng-20191029-end
config TOUCHSCREEN_MTK_FOCALTECH_FHD
	bool "Focaltech FHD Touchscreen"
	depends on I2C
	help
	  Say Y here if you have Focaltech touch panel.
	  If unsure, say N.
#prize-add-lishuwen-20191226-start
config TOUCHSCREEN_MTK_GT1X_V14
	bool "GT1X_V14 for Mediatek package"
	default n
	help
	  Say Y here if you have GT1X_V14 touch panel.
	  If unsure, say N.
	  To compile this dirver as a module, choose M here: the
	  module will be called.
config TOUCHSCREEN_MTK_GT9XX_PRIZE
	bool "GT9XX for Mediatek package"
	default n
	help
	  Say Y here if you have GT9XX touch panel.
	  If unsure, say N.
	  To compile this dirver as a module, choose M here: the
	  module will be called.	  
source "drivers/input/touchscreen/mediatek/GT9XX_prize/Kconfig"
#prize-add-lishuwen-20191226-end
#prize-add-pengzhipeng-20200114-start
config TP_BEFORE_LCM_RESUME
    bool "TP_BEFORE_LCM_RESUME"
	default n
	help
	  Say Y here if you have touch panel.
	  Since the touch panel initialization is not completely completed at the moment of the bright screen,you need to put the touch panel before the screen wakes up.	
#prize-add-pengzhipeng-20200114-end

#diliwu add tp 20191222 start
config TOUCHSCREEN_CHIPONE
        tristate "Chipone TDDI touchscreen for Mediatek package"
        depends on I2C
        default n
        help
          Say y here if you have chipone TDDI touch panel.
          If unsure, say N.
          To compile this driver as a module, choose M here: the
          module will be called chipone-tddi.
#diliwu add tp 20191222 end
#prize Added glove mode control macro-yaozhipeng-20190718-start	  
config PRIZE_SMART_COVER_COMMON_NODE
	bool "prize smart cover common node"
	default n
	help
	  Say Y here if you use smart cover common node.
	  If unsure, say N.
	  To compile this dirver as a module, choose M here: the
	  module will be called.
#prize Added glove mode control macro-yaozhipeng-20190718-end*/
endif
```

## drivers/misc/mediatek/hall_as1800/Kconfig
```kconfig
config PRIZE_DUAL_HALL_AS1800
	bool "PRIZE HALL AS1800"
	default n
	help
		prize dual hall as1800 driver
```

## drivers/misc/mediatek/hall_m120/Kconfig
```kconfig
config SENSOR_HALL_MXM1120
        tristate "mxm1120 hall"
        depends on I2C
        help
          Say Y here if you want support for hall controllers.
          If unsure, say N.

          To compile this driver as a module, choose M here: the
          module will be called sec_ts.
```

## drivers/misc/mediatek/hardware_info/Kconfig
```kconfig
config PRIZE_HARDWARE_INFO
  bool "HARDWARE_INFO"
  default y
  help
    Dummy Lens Driver
    This config is used to enable the corresponding
    lens driver for the camera sensor module
    Set as y if the driver is used in this project

config PRIZE_HARDWARE_INFO_BAT
  bool "PRIZE_HARDWARE_INFO_BAT"
  depends on PRIZE_HARDWARE_INFO
  default n
  help
    This config is used to enable battery info
	displayed in hardware info.
	
config PRIZE_CTS
  bool "HARDWARE_EFUSE_INFO"
  default n
  help
    Dummy EFUSE flown status info
```

## drivers/misc/mediatek/leds/Kconfig
```kconfig
config MTK_LEDS
	tristate "MediaTek LED Support"
	depends on LEDS_CLASS
	---help---
	  This selects the MediaTek(R) LEDs connected to MediaTek chips.
	  If you want to use MediaTek(R) LEDs support, say Y or M here.
	  If unsure, say N.
	  Mediatek LED module includes backlight, indicate LED, keypad LED, button LED etc.

config LIGHTNESS_MAPPING_VALUE
	int "Backlight brightness mapping value"
	default 255
	---help---
	  Backlight brightness mapping value, from 0 to 255.

config BACKLIGHT_SUPPORT_LP8557
	bool "Support backlight lp8557 board"
	default n
	---help---
	  LED driver for LP8557 support.
	  Set y to support.
	  Set n to disable.
	  For pwm external backlight.

config BACKLIGHT_SUPPORT_LM3697
	bool "LM3697(DW8832) Support"
	default n
	---help---
	  LED driver for lm3697(dw8832) support.
	  Set y to support.
	  Set n to disable.
	  Charge pump driver for external backlight.
	  
###prize  lsw add this for breath leds at 20190624 start
config PRIZE_LEDS_AW2015
	tristate "LED Support for AW2015"
	depends on LEDS_CLASS && I2C
	help
		this option enables support for the AW2015 RGB LED connected
		through I2C. Say Y to enable support for the AW2015 LED
###prize  lsw add this for breath leds at 20190624 end
```

## drivers/misc/mediatek/prize/Kconfig
```kconfig
config PRIZE_AUDIO
  bool CONFIG_PRIZE_AUDIO
  default no
  help
    CONFIG_PRIZE_AUDIO
config PRIZE_FP
  bool CONFIG_PRIZE_FP
  default no
  help
    CONFIG_PRIZE_FP
config PRIZE_LCD_BIAS
  bool CONFIG_PRIZE_LCD_BIAS
  default no
  help
    CONFIG_PRIZE_LCD_BIAS

config PRIZE_SCREEN_STATE
  bool CONFIG_PRIZE_SCREEN_STATE
  default no
  help
    CONFIG_PRIZE_SCREEN_STATE


config PRIZE_VEB_A5
  bool PRIZE_VEB_A5
  default no
  help
    PRIZE_VEB_A5	

source "drivers/misc/mediatek/prize/lcdbias/Kconfig
```

## drivers/misc/mediatek/prize/lcdbias/Kconfig
```kconfig
config PRIZE_LCD_BIAS_SGM3804
  bool CONFIG_PRIZE_LCD_BIAS_SGM3804
  depends on PRIZE_LCD_BIAS
  default no
  help
    CONFIG_PRIZE_LCD_BIAS_SGM3804

config PRIZE_LCD_BIAS_TPS65132
  bool CONFIG_PRIZE_LCD_BIAS_TPS65132
  depends on PRIZE_LCD_BIAS
  default no
  help
    CONFIG_PRIZE_LCD_BIAS_TPS65132
```

## drivers/misc/mediatek/prize_dual_cam/Kconfig
```kconfig
config PRIZE_DUAL_CAM_ENABLE
	bool "Support prize_dual_camera function"
	default n
	help
		 Select Y to enable prize_dual_camera function
		 
config PRIZE_DUAL_CAM_ENABLE_REAR
	bool "Support prize_dual_camera rear function"
	default n
	select PRIZE_DUAL_CAM_ENABLE
	help
		Select Y to enable prize_dual_camera function
		 
config PRIZE_DUAL_CAM_ENABLE_FRONT
	bool "Support prize_dual_camera front function"
	default n
	select PRIZE_DUAL_CAM_ENABLE
	help
		Select Y to enable prize_dual_camera function
```

## drivers/misc/mediatek/prize_dual_camera/Kconfig
```kconfig
config PRIZE_DUAL_CAMERA_ENABLE
	bool "Support prize_dual_camera function"
	default n
	help
		 Select Y to enable prize_dual_camera function
		 
config PRIZE_DUAL_CAMERA_ENABLE_REAR
	bool "Support prize_dual_camera rear function"
	default n
	select PRIZE_DUAL_CAMERA_ENABLE
	help
		Select Y to enable prize_dual_camera function
		 
config PRIZE_DUAL_CAMERA_ENABLE_FRONT
	bool "Support prize_dual_camera front function"
	default n
	select PRIZE_DUAL_CAMERA_ENABLE
	help
		Select Y to enable prize_dual_camera function
```

## drivers/misc/mediatek/sensors-1.0/accelerometer/da226/Kconfig
```kconfig
config MTK_DA226
	bool "MTK_DA226 for MediaTek package"
	default n
	help
	  The MIR3DA is a highly integrated,
	  low power internal measurement unit
	  that provides precise acceleration
	  measurement.
	  this config will turn on accelerometer feature.
```

## drivers/misc/mediatek/sensors-1.0/accelerometer/icm426xx_a/Kconfig
```kconfig
config MTK_ICM426XX_A
        bool "ICM426XX for MediaTek package"
        default n
        help
        It support different accelerometer sensor.
        If this option is set,
            it will support
            ICM426XX accelerometer.
```

## drivers/misc/mediatek/sensors-1.0/accelerometer/mxc400x_prize/Kconfig
```kconfig
config MTK_MXC400X_PRIZE
  bool "MXC400X for MediaTek package"
  default n
	help
	  It support different accelerometer sensor.
          If this option is set,
	  it will support
          DA213 Accelerometer.
```

## drivers/misc/mediatek/sensors-1.0/alsps/Kconfig
```kconfig
config CUSTOM_KERNEL_ALSPS
	bool "CUSTOM KERNEL ALSPS Config"
	help
	  ALSPS sensor driver to detect ambient light and the object is close
	  or far awary from device. After configure this configuration,
	  the specific ambient light and proximity sensor driver configuration
	  should be configured as well.

config MTK_AUTO_DETECT_ALSPS
	bool "MTK AUTO DETECT ALSPS Sensor"
	help
	  This feature Option is used for projects which using more than one
	  ALSPS sensors, more than one ALSPS drivers can be builded in to
	  project and be auto detected by setting this option to yes,
	  usually only one ALSPS driver can be probed.

source "drivers/misc/mediatek/sensors-1.0/alsps/alspshub/Kconfig"
source "drivers/misc/mediatek/sensors-1.0/alsps/cm36558/Kconfig"
#prize-add sensor-tangcong-20191231-start
source "drivers/misc/mediatek/sensors-1.0/alsps/stk3x3x/Kconfig"
#prize-add sensor-tangcong-20191231-end
#prize-add sensor-pengzhipeng-20190419-start
source "drivers/misc/mediatek/sensors-1.0/alsps/stk3332_v2000/Kconfig"
#prize-add sensor-pengzhipeng-20190419-end
```

## drivers/misc/mediatek/sensors-1.0/alsps/ltr559/Kconfig
```kconfig
config MTK_LTR559
  bool "LTR559 for MediaTek package"
  default n
	help
	  It support different alsps sensor.
          If this option is set,
	  it will support
          LTR559 alsps.
```

## drivers/misc/mediatek/sensors-1.0/gyroscope/icm426xx_g/Kconfig
```kconfig
config MTK_ICM426XX_G
        bool "ICM426XX for MediaTek package"
        default n
        help
        It support different gyroscope sensor.
        If this option is set,
            it will support
            ICM426XX gyroscope.
```
